## Kconfig
```kconfig
# General configuration options

# Copyright (c) 2014-2015 Wind River Systems, Inc.
# SPDX-License-Identifier: Apache-2.0

mainmenu "Rtochius/$(ARCH) $(RTOCHIUS_VERSION_STRING) Configuration"

source "scripts/Kconfig.include"

source "kernel/Kconfig"

source "lib/Kconfig"

source "uservice/Kconfig"

source "servers/Kconfig"

osource "drivers/Kconfig"
```

## kernel/arch/arm64/Kconfig
```kconfig
# SPDX-License-Identifier: GPL-2.0

config ARM64
	def_bool y
	select ARCH_WANT_FRAME_POINTERS
	select ARCH_WANT_LD_ORPHAN_WARN
	select ARM_GIC
	select ARM_ARCH_TIMER
	select ARM_PSCI_FW
	select FRAME_POINTER
	select HAVE_STACKPROTECTOR
	select OF

config 64BIT
	def_bool y

config ARM64_PAGE_SHIFT
	int
	default 16 if ARM64_64K_PAGES
	default 14 if ARM64_16K_PAGES
	default 12

config ARM64_CONT_SHIFT
	int
	default 5 if ARM64_64K_PAGES
	default 7 if ARM64_16K_PAGES
	default 4

config PGTABLE_LEVELS
	int
	default 2 if ARM64_16K_PAGES && ARM64_VA_BITS_36
	default 2 if ARM64_64K_PAGES && ARM64_VA_BITS_42
	default 3 if ARM64_64K_PAGES && (ARM64_VA_BITS_48)
	default 3 if ARM64_4K_PAGES && ARM64_VA_BITS_39
	default 3 if ARM64_16K_PAGES && ARM64_VA_BITS_47
	default 4 if !ARM64_64K_PAGES && ARM64_VA_BITS_48

source "kernel/arch/arm64/Kconfig.platforms"

menu "Kernel Features"

choice
	prompt "Page size"
	default ARM64_4K_PAGES
	help
	  Page size (translation granule) configuration.

config ARM64_4K_PAGES
	bool "4KB"
	help
	  This feature enables 4KB pages support.

config ARM64_16K_PAGES
	bool "16KB"
	help
	  The system will use 16KB pages support. AArch32 emulation
	  requires applications compiled with 16K (or a multiple of 16K)
	  aligned segments.

config ARM64_64K_PAGES
	bool "64KB"
	help
	  This feature enables 64KB pages support (4KB by default)
	  allowing only two levels of page tables and faster TLB
	  look-up. AArch32 emulation requires applications compiled
	  with 64K aligned segments.

endchoice

choice
	prompt "Virtual address space size"
	default ARM64_VA_BITS_39 if ARM64_4K_PAGES
	default ARM64_VA_BITS_47 if ARM64_16K_PAGES
	default ARM64_VA_BITS_42 if ARM64_64K_PAGES
	help
	  Allows choosing one of multiple possible virtual address
	  space sizes. The level of translation table is determined by
	  a combination of page size and virtual address space size.

config ARM64_VA_BITS_36
	bool "36-bit"
	depends on ARM64_16K_PAGES

config ARM64_VA_BITS_39
	bool "39-bit"
	depends on ARM64_4K_PAGES

config ARM64_VA_BITS_42
	bool "42-bit"
	depends on ARM64_64K_PAGES

config ARM64_VA_BITS_47
	bool "47-bit"
	depends on ARM64_16K_PAGES

config ARM64_VA_BITS_48
	bool "48-bit"

endchoice

config ARM64_VA_BITS
	int
	default 36 if ARM64_VA_BITS_36
	default 39 if ARM64_VA_BITS_39
	default 42 if ARM64_VA_BITS_42
	default 47 if ARM64_VA_BITS_47
	default 48 if ARM64_VA_BITS_48

choice
	prompt "Physical address space size"
	default ARM64_PA_BITS_48
	help
	  Choose the maximum physical address range that the kernel will
	  support.

config ARM64_PA_BITS_48
	bool "48-bit"

endchoice

config ARM64_PA_BITS
	int
	default 48 if ARM64_PA_BITS_48

config CPU_BIG_ENDIAN
	bool "Build big-endian kernel"
	depends on !LD_IS_LLD || LLD_VERSION >= 130000
	help
	  Say Y if you plan on running a kernel with a big-endian userspace.

config NR_CPUS
	int "Maximum number of CPUs (2-4096)"
	range 2 4096
	# These have to remain sorted largest to smallest
	default "64"

config BROKEN_GAS_INST
	bool "Detected assembler with broken .inst"
	default y

source "kernel/core/Kconfig.hz"

endmenu
```

## kernel/arch/arm64/configs/defconfig
```kconfig
CONFIG_ARCH_ORIGIN=y
CONFIG_ARM64_VA_BITS_48=y
CONFIG_NR_CPUS=8
CONFIG_SERIAL_AMBA_PL011=y
CONFIG_FDT=y
CONFIG_QEMU_VIRT=y
CONFIG_QEMU_APPEND="console=ttyAMA0 rodata=nofull"
```

## lib/Kconfig
```kconfig
# SPDX-License-Identifier: GPL-2.0
#
menu "Rtochius Libs configuration"

source "lib/base/Kconfig"

endmenu
```

## lib/base/Kconfig
```kconfig
# SPDX-License-Identifier: GPL-2.0
#
menu "Base Libc configuration"

source "lib/base/arch/Kconfig"

endmenu
```

## lib/base/arch/arm64/Kconfig
```kconfig
config BASE_ARM64
	def_bool y

config ARCH_PHYS_ADDR_T_64BIT
	def_bool y

config ARCH_DMA_ADDR_T_64BIT
	def_bool y
```

## uservice/Kconfig
```kconfig
# SPDX-License-Identifier: GPL-2.0
#
menu "Rtochius Uservice configuration"

menu "Compiler Options"

choice
	prompt "Optimization level"
	default SPEED_OPTIMIZATIONS
	help
	Note that these flags shall only control the compiler
	optimization level, and that no extra debug code shall be
	conditionally compiled based on them.

config SIZE_OPTIMIZATIONS
	bool "Optimize for size"
	help
	  Compiler optimizations will be set to -Os independently of other
	  options.

config SPEED_OPTIMIZATIONS
	bool "Optimize for speed"
	help
	  Compiler optimizations will be set to -O2 independently of other
	  options.

config DEBUG_OPTIMIZATIONS
	bool "Optimize debugging experience"
	help
	  Compiler optimizations will be set to -Og independently of other
	  options.

config NO_OPTIMIZATIONS
	bool "Optimize nothing"
	help
	  Compiler optimizations will be set to -O0 independently of other
	  options.

endchoice

config DEBUG_APP
	bool "Debugging application"
	default n
	depends on !DEBUG_OPTIMIZATIONS
	help
	  Compiler Debug will be set to -g independently of other
	  options.

endmenu

menuconfig QEMU_VIRT
	bool "Qemu virt Support for the application"
	help
	  This option enables qemu virt.

if QEMU_VIRT

config QEMU_SYSTEM
	string "Qemu system select"
	default "aarch64" if ARM64

config QEMU_CPU
	string "Qemu cpu select"
	default "cortex-a57" if ARM64

config QEMU_MACHINE
	string "Qemu machine select"
	default "virt" if ARM64

config QEMU_VIRT_OPTION
	string "Qemu virt optin"
	default "gic-version=2" if ARM64

config QEMU_APPEND
	string "Qemu append"
	default ""

config QEMU_INITRD
	string "Qemu initrd"
	default ""

config QEMU_MEMORY
	string "Qemu memory"
	default "4G"

config QEMU_GRAPHIC
	bool "Qemu graphic"
	default n

config QEMU_DEBUG
	bool "Qemu debug"
	default n

endif

endmenu
```
